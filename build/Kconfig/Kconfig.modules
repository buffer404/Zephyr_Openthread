## build/Kconfig/Kconfig.modules
```kconfig
menu "acpica (/home/leonid/zephyrproject/modules/lib/acpica)"
osource "$(ZEPHYR_ACPICA_KCONFIG)"
config ZEPHYR_ACPICA_MODULE
	bool
	default y
endmenu
menu "canopennode (/home/leonid/zephyrproject/modules/lib/canopennode)"
osource "$(ZEPHYR_CANOPENNODE_KCONFIG)"
config ZEPHYR_CANOPENNODE_MODULE
	bool
	default y
endmenu
menu "cmsis (/home/leonid/zephyrproject/modules/hal/cmsis)"
osource "$(ZEPHYR_CMSIS_KCONFIG)"
config ZEPHYR_CMSIS_MODULE
	bool
	default y
endmenu
menu "cmsis-dsp (/home/leonid/zephyrproject/modules/lib/cmsis-dsp)"
osource "$(ZEPHYR_CMSIS_DSP_KCONFIG)"
config ZEPHYR_CMSIS_DSP_MODULE
	bool
	default y
endmenu
menu "cmsis-nn (/home/leonid/zephyrproject/modules/lib/cmsis-nn)"
osource "$(ZEPHYR_CMSIS_NN_KCONFIG)"
config ZEPHYR_CMSIS_NN_MODULE
	bool
	default y
endmenu
menu "fatfs (/home/leonid/zephyrproject/modules/fs/fatfs)"
osource "$(ZEPHYR_FATFS_KCONFIG)"
config ZEPHYR_FATFS_MODULE
	bool
	default y
endmenu
menu "hal_ambiq (/home/leonid/zephyrproject/modules/hal/ambiq)"
osource "$(ZEPHYR_HAL_AMBIQ_KCONFIG)"
config ZEPHYR_HAL_AMBIQ_MODULE
	bool
	default y
endmenu
menu "hal_espressif (/home/leonid/zephyrproject/modules/hal/espressif)"
osource "/home/leonid/zephyrproject/modules/hal/espressif/zephyr/Kconfig"
config ZEPHYR_HAL_ESPRESSIF_MODULE
	bool
	default y
endmenu
menu "hal_ethos_u (/home/leonid/zephyrproject/modules/hal/ethos_u)"
osource "$(ZEPHYR_HAL_ETHOS_U_KCONFIG)"
config ZEPHYR_HAL_ETHOS_U_MODULE
	bool
	default y
endmenu
menu "hal_gigadevice (/home/leonid/zephyrproject/modules/hal/gigadevice)"
osource "$(ZEPHYR_HAL_GIGADEVICE_KCONFIG)"
config ZEPHYR_HAL_GIGADEVICE_MODULE
	bool
	default y
endmenu
menu "hal_infineon (/home/leonid/zephyrproject/modules/hal/infineon)"
osource "$(ZEPHYR_HAL_INFINEON_KCONFIG)"
config ZEPHYR_HAL_INFINEON_MODULE
	bool
	default y
endmenu
menu "hal_nordic (/home/leonid/zephyrproject/modules/hal/nordic)"
osource "$(ZEPHYR_HAL_NORDIC_KCONFIG)"
config ZEPHYR_HAL_NORDIC_MODULE
	bool
	default y
endmenu
menu "hal_nxp (/home/leonid/zephyrproject/modules/hal/nxp)"
osource "$(ZEPHYR_HAL_NXP_KCONFIG)"
config ZEPHYR_HAL_NXP_MODULE
	bool
	default y
endmenu
menu "hal_rpi_pico (/home/leonid/zephyrproject/modules/hal/rpi_pico)"
osource "$(ZEPHYR_HAL_RPI_PICO_KCONFIG)"
config ZEPHYR_HAL_RPI_PICO_MODULE
	bool
	default y
endmenu
menu "silabs (/home/leonid/zephyrproject/modules/hal/silabs)"
osource "/home/leonid/zephyrproject/modules/hal/silabs/zephyr/Kconfig"
config ZEPHYR_SILABS_MODULE
	bool
	default y
endmenu
menu "hal_telink (/home/leonid/zephyrproject/modules/hal/telink)"
osource "/home/leonid/zephyrproject/modules/hal/telink/Kconfig"
config ZEPHYR_HAL_TELINK_MODULE
	bool
	default y
endmenu
menu "liblc3 (/home/leonid/zephyrproject/modules/lib/liblc3)"
osource "$(ZEPHYR_LIBLC3_KCONFIG)"
config ZEPHYR_LIBLC3_MODULE
	bool
	default y
endmenu
menu "littlefs (/home/leonid/zephyrproject/modules/fs/littlefs)"
osource "$(ZEPHYR_LITTLEFS_KCONFIG)"
config ZEPHYR_LITTLEFS_MODULE
	bool
	default y
endmenu
menu "loramac-node (/home/leonid/zephyrproject/modules/lib/loramac-node)"
osource "$(ZEPHYR_LORAMAC_NODE_KCONFIG)"
config ZEPHYR_LORAMAC_NODE_MODULE
	bool
	default y
endmenu
menu "lvgl (/home/leonid/zephyrproject/modules/lib/gui/lvgl)"
osource "/home/leonid/zephyrproject/modules/lib/gui/lvgl/Kconfig"
config ZEPHYR_LVGL_MODULE
	bool
	default y
endmenu
menu "mbedtls (/home/leonid/zephyrproject/modules/crypto/mbedtls)"
osource "$(ZEPHYR_MBEDTLS_KCONFIG)"
config ZEPHYR_MBEDTLS_MODULE
	bool
	default y
endmenu
menu "openthread (/home/leonid/zephyrproject/modules/lib/openthread)"
osource "$(ZEPHYR_OPENTHREAD_KCONFIG)"
config ZEPHYR_OPENTHREAD_MODULE
	bool
	default y
endmenu
menu "percepio (/home/leonid/zephyrproject/modules/debug/percepio)"
osource "/home/leonid/zephyrproject/modules/debug/percepio/zephyr/Kconfig"
config ZEPHYR_PERCEPIO_MODULE
	bool
	default y
endmenu
menu "picolibc (/home/leonid/zephyrproject/modules/lib/picolibc)"
osource "/home/leonid/zephyrproject/modules/lib/picolibc/zephyr/Kconfig"
config ZEPHYR_PICOLIBC_MODULE
	bool
	default y
endmenu
menu "segger (/home/leonid/zephyrproject/modules/debug/segger)"
osource "$(ZEPHYR_SEGGER_KCONFIG)"
config ZEPHYR_SEGGER_MODULE
	bool
	default y
endmenu
menu "trusted-firmware-m (/home/leonid/zephyrproject/modules/tee/tf-m/trusted-firmware-m)"
osource "$(ZEPHYR_TRUSTED_FIRMWARE_M_KCONFIG)"
config ZEPHYR_TRUSTED_FIRMWARE_M_MODULE
	bool
	default y
endmenu
menu "trusted-firmware-a (/home/leonid/zephyrproject/modules/tee/tf-a/trusted-firmware-a)"
osource "$(ZEPHYR_TRUSTED_FIRMWARE_A_KCONFIG)"
config ZEPHYR_TRUSTED_FIRMWARE_A_MODULE
	bool
	default y
endmenu
menu "uoscore-uedhoc (/home/leonid/zephyrproject/modules/lib/uoscore-uedhoc)"
osource "$(ZEPHYR_UOSCORE_UEDHOC_KCONFIG)"
config ZEPHYR_UOSCORE_UEDHOC_MODULE
	bool
	default y
endmenu
menu "zcbor (/home/leonid/zephyrproject/modules/lib/zcbor)"
osource "$(ZEPHYR_ZCBOR_KCONFIG)"
config ZEPHYR_ZCBOR_MODULE
	bool
	default y
endmenu
menu "lmtlib_light (/home/leonid/zephyrproject/zephyr/zephyr_lmtltd_light/lmtlib_light)"
osource "/home/leonid/zephyrproject/zephyr/zephyr_lmtltd_light/lmtlib_light/Kconfig"
config ZEPHYR_LMTLIB_LIGHT_MODULE
	bool
	default y
endmenu
```

## build/Kconfig/Kconfig.shield
```kconfig
osource "/home/leonid/zephyrproject/zephyr/zephyr_lmtltd_light/lmtlib_light/boards/shields/*/Kconfig.shield"
```

## zephyr_lmtltd_light/applications/cc-app-minimal/cmake-build-debug/Kconfig/Kconfig.shield
```kconfig
osource "/home/mike/zephyr/zephyr/zephyr_lmtltd_light/lmtlib_light/boards/shields/*/Kconfig.shield"
```

## zephyr_lmtltd_light/lmtlib_light/Kconfig
```kconfig
menu "LMT ltd"

rsource "subsys/Kconfig"
rsource "drivers/Kconfig"
rsource "tests/Kconfig"

endmenu
```

## zephyr_lmtltd_light/lmtlib_light/boards/arm/SOIKA/Kconfig.board
```kconfig
# SOIKA board configuration

# Copyright (c) 2019 Linaro Limited
# SPDX-License-Identifier: Apache-2.0

config BOARD_SOIKA
	bool "SOIKA Bird controller"
	depends on SOC_STM32WB55XX
```

## zephyr_lmtltd_light/lmtlib_light/boards/arm/SOVA/Kconfig.board
```kconfig
config BOARD_SOVA427VI
	bool "SOVA427 bird Board"
	depends on SOC_STM32F427XX

config BOARD_SOVA407VG
	bool "SOVA407 bird Board"
	depends on SOC_STM32F407XG

config BOARD_SOVA407VE
	bool "SOVA407 bird Board"
	depends on SOC_STM32F407XE
```

## zephyr_lmtltd_light/lmtlib_light/boards/arm/SOVA/Kconfig.defconfig
```kconfig
if BOARD_SOVA427VI
config BOARD
	default "SOVA427VI"
endif

if BOARD_SOVA407VG
config BOARD
	default "SOVA407VG"
endif

if BOARD_SOVA407VE
config BOARD
	default "SOVA407VE"
endif

if BOARD_SOVA427VI || BOARD_SOVA407VG || BOARD_SOVA407VE

config ARM_MPU
	default y
config HW_STACK_PROTECTION
	default y
config SERIAL
	default y
config CONSOLE
	default y
config UART_CONSOLE
	default y
config GPIO
	default y
config CLOCK_CONTROL
	default y
config PINCTRL
	default y

if NETWORKING

config NET_L2_ETHERNET
	default y

# MCO используется для тактирования Ethernet PHY
# pins.c содержит перевод пина в альтернативный режим
config CLOCK_STM32_MCO1_DIV
	default 1

endif # NETWORKING

endif # BOARD_SOVA4xx
```

## zephyr_lmtltd_light/lmtlib_light/boards/arm/SOVA/SOVA407VE_defconfig
```kconfig
CONFIG_SOC_SERIES_STM32F4X=y
CONFIG_SOC_STM32F407XE=y
CONFIG_CLOCK_STM32_MCO1_SRC_HSE=y
```

## zephyr_lmtltd_light/lmtlib_light/boards/arm/SOVA/SOVA427VI_defconfig
```kconfig
CONFIG_SOC_SERIES_STM32F4X=y
CONFIG_SOC_STM32F427XX=y
CONFIG_CLOCK_STM32_MCO1_SRC_HSE=y
```

## zephyr_lmtltd_light/lmtlib_light/boards/arm/SOVA105/SOVA105_defconfig
```kconfig
# SPDX-License-Identifier: Apache-2.0

CONFIG_SOC_SERIES_STM32F1X=y
CONFIG_SOC_STM32F105XC=y

# enable uart driver
CONFIG_SERIAL=y
# enable console
CONFIG_CONSOLE=y
CONFIG_UART_CONSOLE=y
CONFIG_LOG=y

# enable GPIO
CONFIG_GPIO=y

# enable clocks
CONFIG_CLOCK_CONTROL=y
CONFIG_ENTROPY_GENERATOR=y
CONFIG_TEST_RANDOM_GENERATOR=n
# enable pin controller
CONFIG_PINCTRL=y
# CONFIG_SYS_CLOCK_TICKS_PER_SEC=60000000  
```

## zephyr_lmtltd_light/lmtlib_light/drivers/w1/Kconfig
```kconfig
if W1

rsource "Kconfig.zephyr_gpio"
rsource "Kconfig.zephyr_stm32_tim"

endif # W1
```

## zephyr_lmtltd_light/lmtlib_light/drivers/w1/Kconfig.zephyr_stm32_tim
```kconfig
# Configuration options for the Zephyr serial 1-Wire driver

# Copyright (c) 2022 Thomas Stranger
# SPDX-License-Identifier: Apache-2.0

DT_COMPAT_ZEPHYR_SERIAL := zephyr,w1-gpio

config W1_ZEPHYR_STM32_TIM
	bool "1-wire Serial"
	default y if $(dt_compat_enabled,$(DT_COMPAT_ZEPHYR_SERIAL))
	select USE_STM32_LL_TIM
	select USE_STM32_LL_GPIO
	select USE_STM32_LL_RCC
	depends on SOC_FAMILY_STM32
	depends on DMA
	help
	  This option enables the w1 zephyr serial driver.

	  The bus reset, and bit read and write operations are executed
	  via bytes read and write operations on top of the zephyr
	  serial driver interface.

if W1_ZEPHYR_STM32_TIM

config W1_ZEPHYR_STM32_TIM_BIT_TIMEOUT
	int "Bit read timeout in us"
	default 380
	help
	  The bit read timeout specifies how long the driver tries to read the
	  uart byte (1-wire bit data bit).
	  For serial drivers where poll_out does not block until the transfer is
	  complete, it must at least be greater than 87us (10bits / 115200baud).

endif # W1_ZEPHYR_GPIO
```

## zephyr_lmtltd_light/lmtlib_light/dts/bindings/adc/ti,ads131e08.yaml
```yaml
description: Texas Instruments ADS131E08 Analog to digital converter

include: [adc-controller.yaml, spi-device.yaml]
compatible: "ti,ads131e08-adc"


properties:
    timer:
      type: phandle
      required: false
    drdy-gpios:
      type: phandle-array
      description: Data Ready pin
    nrst-gpios:
      type: phandle-array
      description: nRESET pin
      required: true
    start-gpios:
      type: phandle-array
      description: start pin

io-channel-cells:
  - positive
  - negative
```

## zephyr_lmtltd_light/lmtlib_light/dts/bindings/capture_compare/capture_compare_stm32.yaml
```yaml
description: STM32 radio io

compatible: "st,capture_compare"

include: [base.yaml, pinctrl-device.yaml]

properties:
    timer:
      type: phandle
      required: true
    channel:
      type: int
      required: true
    pinctrl-0:
      required: true
    pinctrl-names:
      required: true
    resolution:
      type: int
      required: false
      default: 16
      enum:
        - 16
        - 32
        - 64
    
```

## zephyr_lmtltd_light/lmtlib_light/dts/bindings/kscan/ti,ads7843.yaml
```yaml
description: Texas Instruments ADS7843 touch controller

include: [kscan.yaml, spi-device.yaml]

compatible: "ti,ads7843"

properties:
    int-gpios:
      type: phandle-array
      required: true
```

## zephyr_lmtltd_light/lmtlib_light/dts/bindings/misc/lmt,hdlc-serial.yaml
```yaml
description: Modbus over serial line device

compatible: "lmt,hdlc-serial"

include: uart-device.yaml

properties:
  de-gpios:
    type: phandle-array
    description: Driver enable pin.
```

## zephyr_lmtltd_light/lmtlib_light/dts/bindings/modem/lmt,sim7500e.yaml
```yaml
description: LMT sim7500e driver

compatible: "lmt,sim7500e"

include: [base.yaml]

properties:

    label:
      required: false

    mdm-power-gpios:
      type: phandle-array
      required: true

    mdm-pwkey-gpios:
      type: phandle-array
      required: true

    mdm-status-gpios:
      type: phandle-array
      required: true
```

## zephyr_lmtltd_light/lmtlib_light/dts/bindings/modem/lmt,sim868e.yaml
```yaml
description: LMT sim868e driver

compatible: "lmt,sim868e"

include: [base.yaml]

properties:

    label:
      required: false

    mdm-power-gpios:
      type: phandle-array
      required: true

    mdm-pwkey-gpios:
      type: phandle-array
      required: true

    mdm-status-gpios:
      type: phandle-array
      required: true
```

## zephyr_lmtltd_light/lmtlib_light/dts/bindings/radio/basic_radio_device.yaml
```yaml
description: basic radio device like ptBLABLA

include: base.yaml

compatible: "basic-radio-device"

properties:
    label:
      type: string
      required: true
```

## zephyr_lmtltd_light/lmtlib_light/dts/bindings/radio/radio_controller.yaml
```yaml
# Copyright (c) 2018, Linaro Limited
# SPDX-License-Identifier: Apache-2.0

description: controller for radio devices

include: base.yaml

compatible: "radio-controller"

bus: radio-controller

properties:
  rf_devices:
    type: phandles
    required: true
```

## zephyr_lmtltd_light/lmtlib_light/dts/bindings/radio/radio_gpio.yaml
```yaml
# Copyright (c) 2018, Linaro Limited
# SPDX-License-Identifier: Apache-2.0

description: radio gpio device

include: base.yaml

compatible: "radio-gpio"

on-bus: radio-controller
```
