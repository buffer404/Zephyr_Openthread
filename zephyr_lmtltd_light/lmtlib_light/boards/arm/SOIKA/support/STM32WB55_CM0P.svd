# STM32WB55_CM0P register map
File version: 1.9
CPU: CM0 r0p1, little endian, MPU, no FPU, 4 interrupt priority bits
Registers are 32-bit, read-write, reset 0x0 unless marked. A register's access mark holds for its fields unless they carry their own. Offsets are from the block's base; lines under a group give offsets from that group; [hi:lo] are bit positions; {n}, {i} and the like mark numbered series; 'fields as' and 'values as' point back to an identical list; <NAME> marks a mode.

## Memory map
0x40000000 TIM2 size 0x400 — General-purpose-timers
0x40002400 LCD size 0x400 — Liquid crystal display controller
0x40002800 RTC size 0x400 — Real-time clock
0x40002C00 WWDG size 0x400 — System window watchdog
0x40003000 IWDG size 0x400 — Independent watchdog
0x40003800 SPI2 size 0x400
0x40005400 I2C1 size 0x400 — Inter-integrated circuit
0x40005C00 I2C3 size 0x400
0x40006000 CRS size 0x400 — Clock recovery system
0x40006800 USB size 0x800 — Universal serial bus full-speed device interface
0x40007C00 LPTIM1 size 0x400 — Low power timer
0x40008000 LPUART1 size 0x400
0x40009400 LPTIM2 size 0x400
0x40010000 SYSCFG_VREFBUF size 0x200
0x40010200 COMP size 0x9 — Comparator instance 1
0x40012C00 TIM1 size 0x400 — Advanced-timers
0x40013000 SPI1 size 0x400 — Serial peripheral interface/Inter-IC sound
0x40013800 USART1 size 0x400 — Universal synchronous asynchronous receiver transmitter
0x40014400 TIM16 size 0x400 — General purpose timers
0x40014800 TIM17 size 0x400 — General purpose timers
0x40015400 SAI1 size 0x400 — Serial audio interface
0x40020000 DMA1 size 0x400 — Direct memory access controller
0x40020400 DMA2 size 0x400 — Direct memory access controller
0x40020800 DMAMUX1 size 0x400 — Direct memory access Multiplexer
0x40023000 CRC size 0x400 — Cyclic redundancy check calculation unit
0x40024000 TSC size 0x400 — Touch sensing controller
0x48000000 GPIOA size 0x400 — General-purpose I/Os
0x48000400 GPIOB size 0x400 — General-purpose I/Os
0x48000800 GPIOC size 0x400 — General-purpose I/Os
0x48000C00 GPIOD size 0x400
0x48001000 GPIOE size 0x400 — General-purpose I/Os
0x48001C00 GPIOH size 0x400 — General-purpose I/Os
0x50040000 ADC size 0x400 — Analog to Digital Converter instance 1
0x50060000 AES1 size 0x400 — Advanced encryption standard hardware accelerator 1
0x58000000 RCC size 0x400 — Reset and clock control
0x58000400 PWR size 0x400 — Power control
0x58000800 EXTI size 0x400 — External interrupt/event controller
0x58000C00 IPCC size 0x400
0x58001000 RNG size 0x400 — Random number generator
0x58001400 HSEM size 0x400
0x58001800 AES2 size 0x400 — Advanced encryption standard hardware accelerator 1
0x58002000 PKA size 0x2000
0x58004000 Flash size 0x90
0xA0001000 QUADSPI size 0x400 — QuadSPI interface
0xE000E008 SCB_ACTRL size 0x5 — System control block ACTLR
0xE000E010 STK size 0x11 — SysTick timer
0xE000E100 NVIC size 0x351 — Nested Vectored Interrupt Controller
0xE000ED00 SCB size 0x41 — System control block
0xE000ED88 FPU_CPACR size 0x5 — Floating point unit CPACR
0xE000ED90 MPU size 0x15 — Memory protection unit
0xE000EF00 NVIC_STIR size 0x5 — Nested vectored interrupt controller
0xE0042000 DBGMCU size 0x400 — Debug support

## Interrupts
1 PVD (EXTI) — PVD through EXTI[16] (C1IMR2[20])
2 RTC_WKUP (RTC) — RTC wakeup interrupt through AIEC[19]
3 USB_HP (USB) — USB high priority interrupt, USB low priority interrupt
4 FLASH (Flash) — Flash global interrupt
5 EXTI0 (EXTI) — EXTI line 1:0 interrupt through EXTI[1:0]
6 EXTI2 (EXTI) — EXTI line 3:2 interrupt through EXTI[3:2]
7 EXTI4 (EXTI) — EXTI line 15:4 interrupt through EXTI[15:4]
8 TSC — TSC global interrupt (C2IMR2[21])
9 DMA1_CH1 (DMA1) — DMA1 channel 3:1 interrupt (C2IMR2[2:0])
10 DMA1_CH4 (DMA1) — DMA1 channel 7:4 interrupt (C2IMR2[6:3])
11 DMA2_CH1 (DMA2) — DMA2 channel 7:1 interrupt (C2IMR2[14:8])
12 ADC1 (ADC) — ADC1 global interrupt
13 LPTIM1 — LPtimer 1 global interrupt
14 LPTIM2 — LPtimer 2 global interrupt
15 TIM1_BRK (TIM1) — Timer 1 break interrupt
16 TIM2 — TIM2 global interrupt
19 IPCC_C2_RX_IT (IPCC) — IPCC CPU2 RX occupied interrupt
20 PKA — Private key accelerator interrupt (C2IMR1[8])
21 AES2 — AES2 global interrupt
22 COMP — COMP2 & COMP1 interrupt through AIEC[21:20]
23 I2C1_EV (I2C1) — I2C1 event interrupt
24 I2C3_EV (I2C3) — I2C3 event interrupt
25 TIM16 — TIM16 global interrupt
26 SPI2 — SPI 2 global interrupt
26 TIM17 — TIM17 global interrupt
27 USART1 — USART1 global interrupt
28 LPUART1 — LPUART1 global interrupt
29 SAI1 — SAI1 A and B global interrupt
34 SPI1 — SPI 1 global interrupt
43 LCD — LCD global interrupt

## Notices in the file
Copyright (c) 2021 STMicroelectronics.
SPDX-License-Identifier: Apache-2.0
Licensed under the Apache License, Version 2.0 (the "License");
you may not use this file except in compliance with the License.
You may obtain a copy of the License at
http://www.apache.org/licenses/LICENSE-2.0
Unless required by applicable law or agreed to in writing, software
distributed under the License is distributed on an "AS IS" BASIS,
WITHOUT WARRANTIES OR CONDITIONS OF ANY KIND, either express or implied.
See the License for the specific language governing permissions and
limitations under the License.
