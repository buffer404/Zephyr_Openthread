/ {
	w1_controller0: zephyr_w1_gpio0 {
		compatible = "zephyr,w1-stm32-tim";
		ctrl-gpios = <&gpioc 1 0>;
		tim-channel = <1>;
		label = "W1_0";
		timer = <&timers2>;
		dmas = <&dma1 1 28 0x5080>,
		   <&dma1 2 29 0x5040>;
		dma-names = "rx", "tx";

		status = "okay";


		ds18b20_0: ds18b20_0 {
			compatible = "maxim,ds18b20";
			family-code = <0x28>;
			resolution = <12>;
			label = "DS18B20_0";
			status = "okay";
		};
	};
};
