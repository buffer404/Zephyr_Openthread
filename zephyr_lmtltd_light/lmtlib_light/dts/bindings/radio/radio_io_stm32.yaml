## zephyr_lmtltd_light/lmtlib_light/dts/bindings/radio/radio_io_stm32.yaml
```yaml
description: STM32 radio io

compatible: "st,radio-io"

# include: [pwm-controller.yaml, base.yaml, pinctrl-device.yaml]

include: [base.yaml, pinctrl-device.yaml]
# status = "okay";
# timer = &timers2;
# rx_pin = <gpioa 15 0>;
# tx_pin = <gpioa 15 0>;

properties:
    timer:
      type: phandle
      required: true
    pinctrl-0:
      required: true
    pinctrl-names:
      required: true
    tim-direct-channel:
      type: int
      required: true
    tim32bit-res:
      type: boolean
      required: false
```

## zephyr_lmtltd_light/lmtlib_light/dts/bindings/radio/ti,cc1200-radio.yaml
```yaml
# Copyright (c) 2018, Linaro Limited
# SPDX-License-Identifier: Apache-2.0

description: Texas Instruments CC1200 wireless transceiver

compatible: "ti,cc1200-radio"

include: [spi-device.yaml, base.yaml]

properties:
    rx_tx_gpios:
      type: phandle-array
      required: true
    nrst-gpios:
      type: phandle-array
      required: true
    timer:
      type: phandle
      required: true
```

## zephyr_lmtltd_light/lmtlib_light/dts/bindings/w1/zephyr,w1-gpio.yaml
```yaml
description: W1 over gpio

compatible: "zephyr,w1-gpio"

include: [base.yaml, w1-master.yaml]


properties:
    ctrl-gpios:
      type: phandle-array
      required: true
```

## zephyr_lmtltd_light/lmtlib_light/dts/bindings/w1/zephyr,w1-stm32-tim.yaml
```yaml
description: W1 over gpio

compatible: "zephyr,w1-stm32-tim"

include: [base.yaml, w1-master.yaml]


properties:
    ctrl-gpios:
      type: phandle-array
      required: true
    timer:
      type: phandle
      required: true
    tim-channel:
      type: int
      required: false
      default: 1
```

## zephyr_lmtltd_light/lmtlib_light/subsys/Kconfig
```kconfig
# Management configuration options

# SPDX-License-Identifier: Apache-2.0

menu "Device Management"

rsource "lmt_settings/Kconfig"

endmenu
```

## zephyr_lmtltd_light/lmtlib_light/subsys/lmt_settings/Kconfig
```kconfig
module = LMT_SETTINGS
module-str = lmt_settings
source "subsys/logging/Kconfig.template.log_config"

config LMT_SETTINGS
    depends on SETTINGS
    depends on SETTINGS_FILE
    bool "key-value storage subsys"

if LMT_SETTINGS

config LMT_SETTINGS_MOUNT_FS
    bool ""
    depends on FILE_SYSTEM
    depends on FILE_SYSTEM_LITTLEFS
    depends on SETTINGS_FILE_PATH="/lfs/config"
    default n

endif
```

## zephyr_lmtltd_light/lmtlib_light/tests/lmt_settings/testcase.yaml
```yaml
common:
  tags: drivers w1 userspace
  harness: ztest
  harness_config:
    fixture: w1_serial_idle
tests:
  subsys.lmt-settings:
    filter:
    platform_allow:
```

## zephyr_lmtltd_light/lmtlib_light/west.yml
```yaml
manifest:
  version: "0.12"
  remotes:
  - name: zephyrproject-rtos
    url-base: https://github.com/zephyrproject-rtos
projects:
  - name: zephyr
    remote: zephyrproject-rtos
    import: true
self:
  path: lmt-ltd
```
