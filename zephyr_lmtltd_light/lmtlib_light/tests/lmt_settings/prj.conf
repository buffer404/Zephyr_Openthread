## CMakeLists.txt
```
# SPDX-License-Identifier: Apache-2.0
list(APPEND ZEPHYR_EXTRA_MODULES ${CMAKE_CURRENT_SOURCE_DIR}/../../../lmtlib)

cmake_minimum_required(VERSION 3.13.1)
set(ENV{BOARD} MCN4)

find_package(Zephyr REQUIRED HINTS $ENV{ZEPHYR_BASE})
project(lmt_settings)



FILE(GLOB app_sources src/*.c)
target_sources(app PRIVATE ${app_sources})
```

## prj.conf
```kconfig
CONFIG_ZTEST=y

CONFIG_SETTINGS=y
CONFIG_SETTINGS_FILE=y
CONFIG_SETTINGS_FILE_PATH="/lfs/config"
CONFIG_LMT_SETTINGS=y

CONFIG_FILE_SYSTEM=y
CONFIG_FILE_SYSTEM_LITTLEFS=y
CONFIG_LMT_SETTINGS_MOUNT_FS=y
CONFIG_FS_LITTLEFS_FMP_DEV=y

CONFIG_SPI=y
CONFIG_SPI_NOR=y
CONFIG_SPI_NOR_FLASH_LAYOUT_PAGE_SIZE=4096
CONFIG_SPI_NOR_SFDP_RUNTIME=y

CONFIG_FLASH=y
CONFIG_FLASH_MAP=y
CONFIG_FLASH_PAGE_LAYOUT=y

CONFIG_MAIN_STACK_SIZE=24000
CONFIG_SYSTEM_WORKQUEUE_STACK_SIZE=24000

#CONFIG_DISK_DRIVER_FLASH=y
#CONFIG_DISK_DRIVERS=y
```

## src/main.c
```c
/*
 * Copyright (c) 2022 Thomas Stranger
 *
 * SPDX-License-Identifier: Apache-2.0
 */

#include <zephyr/kernel.h>
#include <zephyr/ztest.h>
#include <zephyr/lmt/settings.h>
#include "string.h"

void test_lmt_settings_basic(void)
{
    char msg[] = "value1";
    int len = strlen(msg) + 1;
    lmt_settings_save_key_value("key1", msg, len );
    char a[len];
    lmt_settings_get_key_value("key1", a, len);
    zassert_equal(a, msg, "key1 not equal key2");
}

void test_main(void)
{
	ztest_test_suite(lmt_settings, ztest_user_unit_test(test_lmt_settings_basic));

	ztest_run_test_suite(lmt_settings);
}
```
